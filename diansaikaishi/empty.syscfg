/**
 * These arguments were used when this file was generated. They will be automatically applied on subsequent loads
 * via the GUI or CLI. Run CLI with '--help' for additional information on how to override these arguments.
 */
//@cliArgs --device "MSPM0G350X" --package "LQFP-64(PM)" --part "Default"
//@v2CliArgs --device "MSPM0G3507" --package "LQFP-64(PM)"
// @cliArgs --board /ti/boards/LP_MSPM0G3507 --rtos nortos

/**
 * Import the modules used in this configuration.
 */
const SYSCTL = scripting.addModule("/ti/driverlib/SYSCTL");
const GPIO   = scripting.addModule("/ti/driverlib/GPIO", {}, false);
const GPIO1  = GPIO.addInstance();
const GPIO2  = GPIO.addInstance();
const GPIO3  = GPIO.addInstance();
const GPIO4  = GPIO.addInstance();
const GPIO5  = GPIO.addInstance();
const GPIO6  = GPIO.addInstance();
const GPIO7  = GPIO.addInstance();

/**
 * Write custom configuration values to the imported modules.
 */

const Board = scripting.addModule("/ti/driverlib/Board", {}, false);

SYSCTL.forceDefaultClkConfig = true;

GPIO1.$name                             = "GPIO_TB6612_A";
GPIO1.port                              = "PORTA";
GPIO1.associatedPins.create(2);
GPIO1.associatedPins[0].$name           = "AIN2";
GPIO1.associatedPins[0].assignedPin     = "12";
GPIO1.associatedPins[0].initialValue    = "CLEARED";
GPIO1.associatedPins[1].$name           = "AIN1";
GPIO1.associatedPins[1].assignedPin     = "13";
GPIO1.associatedPins[1].initialValue    = "CLEARED";

GPIO2.$name                             = "GPIO_TB6612_B";
GPIO2.port                              = "PORTB";
GPIO2.associatedPins.create(4);
GPIO2.associatedPins[0].$name           = "PWMA";
GPIO2.associatedPins[0].assignedPin     = "15";
GPIO2.associatedPins[0].initialValue    = "CLEARED";
GPIO2.associatedPins[1].$name           = "BIN1";
GPIO2.associatedPins[1].assignedPin     = "0";
GPIO2.associatedPins[1].initialValue    = "CLEARED";
GPIO2.associatedPins[2].$name           = "BIN2";
GPIO2.associatedPins[2].assignedPin     = "1";
GPIO2.associatedPins[2].initialValue    = "CLEARED";
GPIO2.associatedPins[3].$name           = "PWMB";
GPIO2.associatedPins[3].assignedPin     = "16";
GPIO2.associatedPins[3].initialValue    = "CLEARED";

GPIO3.$name                              = "GPIO_ENCODERS";
GPIO3.port                               = "PORTA";
GPIO3.associatedPins.create(4);
GPIO3.associatedPins[0].$name            = "MOTOR_A_ENCA";
GPIO3.associatedPins[0].assignedPin      = "15";
GPIO3.associatedPins[0].direction        = "INPUT";
GPIO3.associatedPins[0].internalResistor = "PULL_UP";
GPIO3.associatedPins[0].interruptEn      = true;
GPIO3.associatedPins[0].polarity         = "RISE_FALL";
GPIO3.associatedPins[1].$name            = "MOTOR_A_ENCB";
GPIO3.associatedPins[1].assignedPin      = "16";
GPIO3.associatedPins[1].direction        = "INPUT";
GPIO3.associatedPins[1].internalResistor = "PULL_UP";
GPIO3.associatedPins[2].$name            = "MOTOR_B_ENCA";
GPIO3.associatedPins[2].assignedPin      = "17";
GPIO3.associatedPins[2].direction        = "INPUT";
GPIO3.associatedPins[2].internalResistor = "PULL_UP";
GPIO3.associatedPins[2].interruptEn      = true;
GPIO3.associatedPins[2].polarity         = "RISE_FALL";
GPIO3.associatedPins[3].$name            = "MOTOR_B_ENCB";
GPIO3.associatedPins[3].assignedPin      = "24";
GPIO3.associatedPins[3].direction        = "INPUT";
GPIO3.associatedPins[3].internalResistor = "PULL_UP";

GPIO4.$name                         = "GPIO_TRACK_A";
GPIO4.port                          = "PORTA";
GPIO4.associatedPins.create(2);
GPIO4.associatedPins[0].$name       = "S4";
GPIO4.associatedPins[0].assignedPin = "14";
GPIO4.associatedPins[0].direction   = "INPUT";
GPIO4.associatedPins[1].$name       = "S8";
GPIO4.associatedPins[1].assignedPin = "7";
GPIO4.associatedPins[1].direction   = "INPUT";

GPIO5.$name                         = "GPIO_TRACK_B";
GPIO5.port                          = "PORTB";
GPIO5.associatedPins.create(6);
GPIO5.associatedPins[0].$name       = "S1";
GPIO5.associatedPins[0].assignedPin = "25";
GPIO5.associatedPins[0].direction   = "INPUT";
GPIO5.associatedPins[1].$name       = "S2";
GPIO5.associatedPins[1].assignedPin = "24";
GPIO5.associatedPins[1].direction   = "INPUT";
GPIO5.associatedPins[2].$name       = "S3";
GPIO5.associatedPins[2].assignedPin = "20";
GPIO5.associatedPins[2].direction   = "INPUT";
GPIO5.associatedPins[3].$name       = "S5";
GPIO5.associatedPins[3].assignedPin = "18";
GPIO5.associatedPins[3].direction   = "INPUT";
GPIO5.associatedPins[4].$name       = "S6";
GPIO5.associatedPins[4].assignedPin = "19";
GPIO5.associatedPins[4].direction   = "INPUT";
GPIO5.associatedPins[5].$name       = "S7";
GPIO5.associatedPins[5].assignedPin = "10";
GPIO5.associatedPins[5].direction   = "INPUT";

GPIO6.$name                              = "GPIO_OLED";
GPIO6.port                               = "PORTA";
GPIO6.associatedPins.create(2);
GPIO6.associatedPins[0].$name            = "SDA";
GPIO6.associatedPins[0].assignedPin      = "28";
GPIO6.associatedPins[0].initialValue     = "SET";
GPIO6.associatedPins[1].$name            = "SCL";
GPIO6.associatedPins[1].assignedPin      = "31";
GPIO6.associatedPins[1].initialValue     = "SET";

GPIO7.$name                              = "GPIO_KEYS";
GPIO7.port                               = "PORTA";
GPIO7.associatedPins.create(3);
GPIO7.associatedPins[0].$name            = "K1";
GPIO7.associatedPins[0].assignedPin      = "26";
GPIO7.associatedPins[0].direction        = "INPUT";
GPIO7.associatedPins[0].internalResistor = "PULL_UP";
GPIO7.associatedPins[1].$name            = "K2";
GPIO7.associatedPins[1].assignedPin      = "25";
GPIO7.associatedPins[1].direction        = "INPUT";
GPIO7.associatedPins[1].internalResistor = "PULL_UP";
GPIO7.associatedPins[2].$name            = "K3";
GPIO7.associatedPins[2].assignedPin      = "27";
GPIO7.associatedPins[2].direction        = "INPUT";
GPIO7.associatedPins[2].internalResistor = "PULL_UP";
